#include <mega32.h>
#include <delay.h>
#include <stdio.h>
#include "Includes/GLCD.h"


flash unsigned char clock[]=
{
    0x00,0x00,0x00,0x00,0x00,0x00,0x00,0x00,0x00,0x00,0x00,0x80,0x80,0x40,0x20,0x20,0x90,0x88,
    0x08,0x00,0x04,0x04,0x02,0x02,0x02,0x02,0x01,0x01,0x01,0x01,0x01,0xF9,0x01,0x01,0x01,0x01,
    0x01,0x01,0x02,0x02,0x02,0x02,0x04,0x04,0x80,0xC8,0x08,0x10,0x20,0x20,0x40,0x80,0x80,0x00,
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    0x00,0x00,0x00,0x00,0x00,0x00,0x00,0x00,0x00,0x00,0x00,0x00,0x00,0x00,0x00,0x00
};


unsigned char str[10];

long int i = 0;

interrupt [TIM0_OVF] void timer0_ovf_isr(void)
{
     i++;
}

void main(void)
{
    int hour = 10, min = 35, sec = 30, Rh = 15, Rs = 23, Rm = 20;
    float Xh = 0, Yh = 0, Xs = 0, Ys = 0, Xm, Ym, H;
    H = hour + (min/60.0);

    DDRA=(1<<DDA7) | (1<<DDA6) | (1<<DDA5) | (1<<DDA4) | (1<<DDA3) | (1<<DDA2) | (1<<DDA1) | (1<<DDA0);
    DDRC=(0<<DDC7) | (0<<DDC6) | (0<<DDC5) | (0<<DDC4) | (0<<DDC3) | (0<<DDC2) | (0<<DDC1) | (0<<DDC0);

    // Timer/Counter 0 initialization
    // Clock source: System Clock
    // Clock value: 1000/000 kHz
    // Mode: Normal top=0xFF
    // OC0 output: Disconnected
    // Timer Period: 0/256 ms
    TCCR0=(0<<WGM00) | (0<<COM01) | (0<<COM00) | (0<<WGM01) | (0<<CS02) | (0<<CS01) | (1<<CS00);
    TIMSK=(0<<OCIE2) | (0<<TOIE2) | (0<<TICIE1) | (0<<OCIE1A) | (0<<OCIE1B) | (0<<TOIE1) | (0<<OCIE0) | (1<<TOIE0);
    ACSR=(1<<ACD) | (0<<ACBG) | (0<<ACO) | (0<<ACI) | (0<<ACIE) | (0<<ACIC) | (0<<ACIS1) | (0<<ACIS0);
    TCNT0=0x00;
    OCR0=0x00;

    glcd_on();
    glcd_clear();
    bmp_disp(clock, 0, 0, 127, 7);
    point_at(32, 32, 1);

    #asm("sei")
    
    while (1)
    {
        if(i*256 + TCNT0>=999999)
        {
            line(32, 32, Xs, Ys, 0, 0);
            sec++;
            i = 0;
            TCNT0 = 0;
            Xh = Rh*cos((3-H)*2*3.1415/12)+32;
            Yh=-Rh*sin((3-H)*2*3.1415/12)+32;
            line(32,32,Xh,Yh,0,1); 
            Xm=Rm*cos((15-min)*2*3.1415/60)+32;
            Ym=-Rm*sin((15-min)*2*3.1415/60)+32; 
            line(32,32,Xm,Ym,0,1);
            Xs=(Rs*cos((15-sec)*2*3.1415/60))+32;
            Ys=-Rs*sin((15-sec)*2*3.1415/60)+32;
            line(32,32,Xs,Ys,0,1);
            sprintf(str,"%02d:%02d:%02d",hour,min,sec);
            glcd_puts(str,60,7,0,1,0);
          
         
            if(sec == 59)
            {
                sec = 0;
                min++;
                line(32,32,Xm,Ym,0,0);
                if(min == 59)
                {
                    min = 0;
                    hour++;
                    line(32, 32, Xh, Yh, 0, 0);
                    if(hour == 24)
                        hour = min = sec = 0;
                }
            } 
        }      
    }//End While() 
}//End Main()



        